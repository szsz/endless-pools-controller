## sdkconfig.defaults
```kconfig
# SDK config defaults for ESP32-S3 + Arduino-ESP32 v3.x
# Enable SPI Ethernet support in the Arduino core / ESP-IDF
CONFIG_ETH_USE_SPI_ETHERNET=y
CONFIG_ETH_SPI_ETHERNET_W5500=y

# Optional: increase lwIP sockets if needed for AsyncWebServer load
# CONFIG_LWIP_MAX_SOCKETS=16

# Optional: mDNS robustness (not required)
# CONFIG_MDNS_MAX_SERVICES=10

# Panic behavior: print full backtrace and halt (easier to capture/inspect)
CONFIG_ESP_SYSTEM_PANIC_PRINT_HALT=y
# Alternative: enter GDB stub on panic (uncomment if you want to attach GDB on crash)
# CONFIG_ESP_SYSTEM_PANIC_GDBSTUB=y
```
